## examples/qemu-node/buildroot-external/configs/graphx_qemu_x86_64_defconfig
```kconfig
BR2_x86_64=y
BR2_PACKAGE_HOST_LINUX_HEADERS_CUSTOM_6_12=y
BR2_TOOLCHAIN_BUILDROOT_MUSL=y
BR2_GLOBAL_PATCH_DIR="board/qemu/patches"
BR2_DOWNLOAD_FORCE_CHECK_HASHES=y
BR2_SYSTEM_DHCP=""
BR2_TARGET_GENERIC_HOSTNAME="graphx-qemu-node"
BR2_TARGET_GENERIC_ISSUE="GraphX external raw TCP/UDP QEMU prototype"
BR2_ROOTFS_OVERLAY="$(BR2_EXTERNAL_GRAPHX_QEMU_PATH)/board/rootfs-overlay"
BR2_LINUX_KERNEL=y
BR2_LINUX_KERNEL_CUSTOM_VERSION=y
BR2_LINUX_KERNEL_CUSTOM_VERSION_VALUE="6.12.27"
BR2_LINUX_KERNEL_USE_CUSTOM_CONFIG=y
BR2_LINUX_KERNEL_CUSTOM_CONFIG_FILE="board/qemu/x86_64/linux.config"
BR2_LINUX_KERNEL_NEEDS_HOST_LIBELF=y
BR2_PACKAGE_GRAPHX_QEMU_NODE=y
BR2_TARGET_ROOTFS_CPIO=y
BR2_TARGET_ROOTFS_CPIO_GZIP=y
# BR2_TARGET_ROOTFS_TAR is not set
```

## examples/qemu-node/buildroot-external/package/graphx-qemu-node/Config.in
```kconfig
config BR2_PACKAGE_GRAPHX_QEMU_NODE
	bool "graphx-qemu-node"
	help
	  Raw TCP/UDP echo and traffic generator used by the QEMU TAP/OVS
	  GraphX topology example. The program has no GraphX dependencies.
```

## guests/buildroot-external/configs/graphx_echo_x86_defconfig
```kconfig
BR2_x86_64=y
BR2_PACKAGE_HOST_LINUX_HEADERS_CUSTOM_6_12=y
BR2_TOOLCHAIN_BUILDROOT_MUSL=y
BR2_GLOBAL_PATCH_DIR="board/qemu/patches"
BR2_DOWNLOAD_FORCE_CHECK_HASHES=y
BR2_WGET="wget -nd -t 3 --connect-timeout=10 --timeout=30"
BR2_REPRODUCIBLE=y
BR2_SYSTEM_DHCP=""
BR2_TARGET_GENERIC_HOSTNAME="graphx-qemu-node"
BR2_TARGET_GENERIC_ISSUE="GraphX QEMU TAP/OVS guest"
BR2_ROOTFS_OVERLAY="$(BR2_EXTERNAL_GRAPHX_GUEST_PATH)/board/overlay"
BR2_LINUX_KERNEL=y
BR2_LINUX_KERNEL_CUSTOM_VERSION=y
BR2_LINUX_KERNEL_CUSTOM_VERSION_VALUE="6.12.27"
BR2_LINUX_KERNEL_USE_CUSTOM_CONFIG=y
BR2_LINUX_KERNEL_CUSTOM_CONFIG_FILE="board/qemu/x86_64/linux.config"
BR2_LINUX_KERNEL_NEEDS_HOST_LIBELF=y
BR2_TOOLCHAIN_BUILDROOT_CXX=y
BR2_PACKAGE_GRAPHX_GUEST=y
BR2_PACKAGE_PYTHON3=y
BR2_PACKAGE_PYTHON3_PY_ONLY=y
BR2_PACKAGE_PYTHON3_SSL=y
BR2_PACKAGE_OPENSSL=y
BR2_TARGET_ROOTFS_CPIO=y
BR2_TARGET_ROOTFS_CPIO_GZIP=y
# BR2_TARGET_ROOTFS_TAR is not set
BR2_LINUX_KERNEL_CONFIG_FRAGMENT_FILES="$(BR2_EXTERNAL_GRAPHX_GUEST_PATH)/board/virtio.config"
```

## guests/buildroot-external/package/graphx-guest/Config.in
```kconfig
config BR2_PACKAGE_GRAPHX_GUEST
	bool "GraphX guest applications and configuration agent"
	depends on BR2_INSTALL_LIBSTDCPP
	select BR2_PACKAGE_OPENSSL
	select BR2_PACKAGE_PYTHON3
	select BR2_PACKAGE_PYTHON3_SSL

config BR2_PACKAGE_GRAPHX_GUEST_APPLICATION
	string "Guest application contract"
	default "guest.echo"
```
